## codeVooraanMetZephyr/build/Kconfig/Kconfig.modules
```kconfig
menu "nrf (D:/programmas/ncs/v2.5.0/nrf)"
osource "D:/programmas/ncs/v2.5.0/nrf/Kconfig.nrf"
config ZEPHYR_NRF_MODULE
	bool
	default y
endmenu
menu "wfa-qt-control-app (D:/programmas/ncs/v2.5.0/modules/lib/wfa-qt-control-app)"
osource "D:/programmas/ncs/v2.5.0/modules/lib/wfa-qt-control-app/zephyr/Kconfig"
config ZEPHYR_WFA_QT_CONTROL_APP_MODULE
	bool
	default y
endmenu
menu "mcuboot (D:/programmas/ncs/v2.5.0/bootloader/mcuboot)"
osource "$(ZEPHYR_MCUBOOT_KCONFIG)"
config ZEPHYR_MCUBOOT_MODULE
	bool
	default y
endmenu
menu "mbedtls (D:/programmas/ncs/v2.5.0/modules/crypto/mbedtls)"
osource "$(ZEPHYR_MBEDTLS_KCONFIG)"
config ZEPHYR_MBEDTLS_MODULE
	bool
	default y
endmenu
menu "trusted-firmware-m (D:/programmas/ncs/v2.5.0/modules/tee/tf-m/trusted-firmware-m)"
osource "$(ZEPHYR_TRUSTED_FIRMWARE_M_KCONFIG)"
config ZEPHYR_TRUSTED_FIRMWARE_M_MODULE
	bool
	default y
endmenu
menu "cjson (D:/programmas/ncs/v2.5.0/modules/lib/cjson)"
osource "$(ZEPHYR_CJSON_KCONFIG)"
config ZEPHYR_CJSON_MODULE
	bool
	default y
endmenu
menu "azure-sdk-for-c (D:/programmas/ncs/v2.5.0/modules/lib/azure-sdk-for-c)"
osource "$(ZEPHYR_AZURE_SDK_FOR_C_KCONFIG)"
config ZEPHYR_AZURE_SDK_FOR_C_MODULE
	bool
	default y
endmenu
menu "cirrus-logic (D:/programmas/ncs/v2.5.0/modules/hal/cirrus-logic)"
osource "D:/programmas/ncs/v2.5.0/modules/hal/cirrus-logic/Kconfig"
config ZEPHYR_CIRRUS_LOGIC_MODULE
	bool
	default y
endmenu
menu "openthread (D:/programmas/ncs/v2.5.0/modules/lib/openthread)"
osource "$(ZEPHYR_OPENTHREAD_KCONFIG)"
config ZEPHYR_OPENTHREAD_MODULE
	bool
	default y
endmenu
menu "memfault-firmware-sdk (D:/programmas/ncs/v2.5.0/modules/lib/memfault-firmware-sdk)"
osource "D:/programmas/ncs/v2.5.0/modules/lib/memfault-firmware-sdk/ports/zephyr/Kconfig"
config ZEPHYR_MEMFAULT_FIRMWARE_SDK_MODULE
	bool
	default y
endmenu
menu "canopennode (D:/programmas/ncs/v2.5.0/modules/lib/canopennode)"
osource "$(ZEPHYR_CANOPENNODE_KCONFIG)"
config ZEPHYR_CANOPENNODE_MODULE
	bool
	default y
endmenu
menu "chre (D:/programmas/ncs/v2.5.0/modules/lib/chre)"
osource "D:/programmas/ncs/v2.5.0/modules/lib/chre/platform/zephyr/Kconfig"
config ZEPHYR_CHRE_MODULE
	bool
	default y
endmenu
menu "cmsis (D:/programmas/ncs/v2.5.0/modules/hal/cmsis)"
osource "$(ZEPHYR_CMSIS_KCONFIG)"
config ZEPHYR_CMSIS_MODULE
	bool
	default y
endmenu
menu "fatfs (D:/programmas/ncs/v2.5.0/modules/fs/fatfs)"
osource "$(ZEPHYR_FATFS_KCONFIG)"
config ZEPHYR_FATFS_MODULE
	bool
	default y
endmenu
menu "hal_nordic (D:/programmas/ncs/v2.5.0/modules/hal/nordic)"
osource "$(ZEPHYR_HAL_NORDIC_KCONFIG)"
config ZEPHYR_HAL_NORDIC_MODULE
	bool
	default y
endmenu
menu "liblc3 (D:/programmas/ncs/v2.5.0/modules/lib/liblc3)"
osource "$(ZEPHYR_LIBLC3_KCONFIG)"
config ZEPHYR_LIBLC3_MODULE
	bool
	default y
endmenu
menu "littlefs (D:/programmas/ncs/v2.5.0/modules/fs/littlefs)"
osource "$(ZEPHYR_LITTLEFS_KCONFIG)"
config ZEPHYR_LITTLEFS_MODULE
	bool
	default y
endmenu
menu "loramac-node (D:/programmas/ncs/v2.5.0/modules/lib/loramac-node)"
osource "$(ZEPHYR_LORAMAC_NODE_KCONFIG)"
config ZEPHYR_LORAMAC_NODE_MODULE
	bool
	default y
endmenu
menu "lvgl (D:/programmas/ncs/v2.5.0/modules/lib/gui/lvgl)"
osource "D:/programmas/ncs/v2.5.0/modules/lib/gui/lvgl/Kconfig"
config ZEPHYR_LVGL_MODULE
	bool
	default y
endmenu
menu "lz4 (D:/programmas/ncs/v2.5.0/modules/lib/lz4)"
osource "$(ZEPHYR_LZ4_KCONFIG)"
config ZEPHYR_LZ4_MODULE
	bool
	default y
endmenu
menu "nanopb (D:/programmas/ncs/v2.5.0/modules/lib/nanopb)"
osource "$(ZEPHYR_NANOPB_KCONFIG)"
config ZEPHYR_NANOPB_MODULE
	bool
	default y
endmenu
menu "picolibc (D:/programmas/ncs/v2.5.0/modules/lib/picolibc)"
osource "D:/programmas/ncs/v2.5.0/modules/lib/picolibc/zephyr/Kconfig"
config ZEPHYR_PICOLIBC_MODULE
	bool
	default y
endmenu
menu "segger (D:/programmas/ncs/v2.5.0/modules/debug/segger)"
osource "$(ZEPHYR_SEGGER_KCONFIG)"
config ZEPHYR_SEGGER_MODULE
	bool
	default y
endmenu
menu "TraceRecorder (D:/programmas/ncs/v2.5.0/modules/debug/TraceRecorder)"
osource "D:/programmas/ncs/v2.5.0/modules/debug/TraceRecorder/kernelports/Zephyr/Kconfig"
config ZEPHYR_TRACERECORDER_MODULE
	bool
	default y
endmenu
menu "uoscore-uedhoc (D:/programmas/ncs/v2.5.0/modules/lib/uoscore-uedhoc)"
osource "$(ZEPHYR_UOSCORE_UEDHOC_KCONFIG)"
config ZEPHYR_UOSCORE_UEDHOC_MODULE
	bool
	default y
endmenu
menu "zcbor (D:/programmas/ncs/v2.5.0/modules/lib/zcbor)"
osource "$(ZEPHYR_ZCBOR_KCONFIG)"
config ZEPHYR_ZCBOR_MODULE
	bool
	default y
endmenu
menu "zscilib (D:/programmas/ncs/v2.5.0/modules/lib/zscilib)"
osource "D:/programmas/ncs/v2.5.0/modules/lib/zscilib/Kconfig.zscilib"
config ZEPHYR_ZSCILIB_MODULE
	bool
	default y
endmenu
menu "nrfxlib (D:/programmas/ncs/v2.5.0/nrfxlib)"
osource "D:/programmas/ncs/v2.5.0/nrfxlib/Kconfig.nrfxlib"
config ZEPHYR_NRFXLIB_MODULE
	bool
	default y
endmenu
menu "connectedhomeip (D:/programmas/ncs/v2.5.0/modules/lib/matter)"
osource "D:/programmas/ncs/v2.5.0/modules/lib/matter/config/nrfconnect/chip-module/Kconfig"
config ZEPHYR_CONNECTEDHOMEIP_MODULE
	bool
	default y
endmenu
```

## codeVooraanMetZephyr/build/Kconfig/Kconfig.shield
```kconfig
osource "c:/users/user/documents/github/vooraan/bt-fund-main/lesson1/blefund_less1_exer1/boards/shields/*/Kconfig.shield"
osource "c:/users/user/documents/github/vooraan/codevooraanmetzephyr/boards/shields/*/Kconfig.shield"
osource "c:/users/user/documents/github/vooraan/bt-fund-main/lesson2/blefund_less2_exer1/boards/shields/*/Kconfig.shield"
osource "C:/ncs/v2.5.0/nrf/boards/shields/*/Kconfig.shield"
```

## codeVooraanMetZephyr/build/Kconfig/Kconfig.shield.defconfig
```kconfig
osource "c:/direct_test_mode/boards/shields/*/Kconfig.defconfig"
osource "d:/school/master-iot/vooraan/bt-fund-main/lesson2/blefund_less2_exer1_solution/boards/shields/*/Kconfig.defconfig"
osource "d:/school/master-iot/vooraan/codevooraanmetzephyr/boards/shields/*/Kconfig.defconfig"
osource "D:/programmas/ncs/v2.5.0/nrf/boards/shields/*/Kconfig.defconfig"
```

## codeVooraanMetZephyr/build/Kconfig/Kconfig.sysbuild.modules
```kconfig
menu "nrf (D:/programmas/ncs/v2.5.0/nrf)"
osource "D:/programmas/ncs/v2.5.0/nrf/sysbuild/Kconfig.sysbuild"
config ZEPHYR_NRF_MODULE
	bool
	default y
endmenu
```
